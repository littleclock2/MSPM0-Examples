/**
 * @cliArgs --device "MSPM0L130X" --package "VQFN-32(RHB)" --part "Default" --product "mspm0_sdk@1.20.01.06"
 * @versions {"tool":"1.18.1+3343"}
 */

/**
 * Import the modules used in this configuration.
 */
const Board  = scripting.addModule("/ti/driverlib/Board");
const GPIO   = scripting.addModule("/ti/driverlib/GPIO", {}, false);
const GPIO1  = GPIO.addInstance();
const GPIO2  = GPIO.addInstance();
const SYSCTL = scripting.addModule("/ti/driverlib/SYSCTL");

/**
 * Write custom configuration values to the imported modules.
 */
const gate7  = system.clockTree["MFPCLKGATE"];
gate7.enable = true;


GPIO1.port                           = "PORTA";
GPIO1.$name                          = "LED";
GPIO1.associatedPins.create(3);
GPIO1.associatedPins[0].initialValue = "SET";
GPIO1.associatedPins[0].assignedPin  = "3";
GPIO1.associatedPins[0].$name        = "USER";
GPIO1.associatedPins[1].$name        = "LED0";
GPIO1.associatedPins[1].initialValue = "SET";
GPIO1.associatedPins[1].assignedPin  = "8";
GPIO1.associatedPins[2].$name        = "LED1";
GPIO1.associatedPins[2].initialValue = "SET";
GPIO1.associatedPins[2].assignedPin  = "9";

GPIO2.port                          = "PORTA";
GPIO2.$name                         = "KEY";
GPIO2.associatedPins[0].direction   = "INPUT";
GPIO2.associatedPins[0].interruptEn = true;
GPIO2.associatedPins[0].polarity    = "FALL";
GPIO2.associatedPins[0].$name       = "KEY0";
GPIO2.associatedPins[0].assignedPin = "1";

SYSCTL.MFCLKEn     = true;
SYSCTL.MFPCLKEn    = true;
SYSCTL.clockTreeEn = true;

/**
 * Pinmux solution for unlocked pins/peripherals. This ensures that minor changes to the automatic solver in a future
 * version of the tool will not impact the pinmux you originally saw.  These lines can be completely deleted in order to
 * re-solve from scratch.
 */
Board.peripheral.$suggestSolution            = "DEBUGSS";
Board.peripheral.swclkPin.$suggestSolution   = "PA20";
Board.peripheral.swdioPin.$suggestSolution   = "PA19";
GPIO1.associatedPins[0].pin.$suggestSolution = "PA3";
GPIO1.associatedPins[1].pin.$suggestSolution = "PA8";
GPIO1.associatedPins[2].pin.$suggestSolution = "PA9";
GPIO2.associatedPins[0].pin.$suggestSolution = "PA1";
