/**
 * @cliArgs --device "MSPM0L130X" --package "VQFN-32(RHB)" --part "Default" --product "mspm0_sdk@1.20.01.06"
 * @versions {"tool":"1.18.1+3343"}
 */

/**
 * Import the modules used in this configuration.
 */
const Board  = scripting.addModule("/ti/driverlib/Board");
const GPIO   = scripting.addModule("/ti/driverlib/GPIO", {}, false);
const GPIO1  = GPIO.addInstance();
const GPIO2  = GPIO.addInstance();
const SYSCTL = scripting.addModule("/ti/driverlib/SYSCTL");

/**
 * Write custom configuration values to the imported modules.
 */
const gate6  = system.clockTree["MFCLKGATE"];
gate6.enable = true;

const gate7  = system.clockTree["MFPCLKGATE"];
gate7.enable = true;


GPIO1.port                           = "PORTA";
GPIO1.$name                          = "LED";
GPIO1.associatedPins.create(8);
GPIO1.associatedPins[0].initialValue = "SET";
GPIO1.associatedPins[0].assignedPin  = "8";
GPIO1.associatedPins[0].$name        = "LED0";
GPIO1.associatedPins[1].assignedPin  = "9";
GPIO1.associatedPins[1].initialValue = "SET";
GPIO1.associatedPins[1].$name        = "LED1";
GPIO1.associatedPins[2].assignedPin  = "10";
GPIO1.associatedPins[2].initialValue = "SET";
GPIO1.associatedPins[2].$name        = "LED2";
GPIO1.associatedPins[3].assignedPin  = "11";
GPIO1.associatedPins[3].initialValue = "SET";
GPIO1.associatedPins[3].$name        = "LED3";
GPIO1.associatedPins[4].assignedPin  = "2";
GPIO1.associatedPins[4].initialValue = "SET";
GPIO1.associatedPins[4].$name        = "LED4";
GPIO1.associatedPins[5].assignedPin  = "3";
GPIO1.associatedPins[5].initialValue = "SET";
GPIO1.associatedPins[5].$name        = "LED5";
GPIO1.associatedPins[6].assignedPin  = "15";
GPIO1.associatedPins[6].initialValue = "SET";
GPIO1.associatedPins[6].$name        = "LED6";
GPIO1.associatedPins[7].initialValue = "SET";
GPIO1.associatedPins[7].$name        = "LED7";
GPIO1.associatedPins[7].assignedPin  = "4";

GPIO2.$name                              = "MAT_KEY";
GPIO2.port                               = "PORTA";
GPIO2.associatedPins.create(8);
GPIO2.associatedPins[0].$name            = "ROW0";
GPIO2.associatedPins[0].assignedPin      = "0";
GPIO2.associatedPins[0].initialValue     = "SET";
GPIO2.associatedPins[1].$name            = "ROW1";
GPIO2.associatedPins[1].assignedPin      = "1";
GPIO2.associatedPins[1].initialValue     = "SET";
GPIO2.associatedPins[2].$name            = "ROW2";
GPIO2.associatedPins[2].assignedPin      = "7";
GPIO2.associatedPins[2].initialValue     = "SET";
GPIO2.associatedPins[3].$name            = "ROW3";
GPIO2.associatedPins[3].assignedPin      = "12";
GPIO2.associatedPins[3].initialValue     = "SET";
GPIO2.associatedPins[4].$name            = "COL0";
GPIO2.associatedPins[4].initialValue     = "SET";
GPIO2.associatedPins[4].assignedPin      = "13";
GPIO2.associatedPins[4].direction        = "INPUT";
GPIO2.associatedPins[4].internalResistor = "PULL_UP";
GPIO2.associatedPins[5].$name            = "COL1";
GPIO2.associatedPins[5].initialValue     = "SET";
GPIO2.associatedPins[5].assignedPin      = "14";
GPIO2.associatedPins[5].direction        = "INPUT";
GPIO2.associatedPins[5].internalResistor = "PULL_UP";
GPIO2.associatedPins[6].$name            = "COL2";
GPIO2.associatedPins[6].initialValue     = "SET";
GPIO2.associatedPins[6].assignedPin      = "17";
GPIO2.associatedPins[6].direction        = "INPUT";
GPIO2.associatedPins[6].internalResistor = "PULL_UP";
GPIO2.associatedPins[7].$name            = "COL3";
GPIO2.associatedPins[7].initialValue     = "SET";
GPIO2.associatedPins[7].assignedPin      = "18";
GPIO2.associatedPins[7].direction        = "INPUT";
GPIO2.associatedPins[7].internalResistor = "PULL_UP";

SYSCTL.MFCLKEn     = true;
SYSCTL.MFPCLKEn    = true;
SYSCTL.clockTreeEn = true;

/**
 * Pinmux solution for unlocked pins/peripherals. This ensures that minor changes to the automatic solver in a future
 * version of the tool will not impact the pinmux you originally saw.  These lines can be completely deleted in order to
 * re-solve from scratch.
 */
Board.peripheral.$suggestSolution            = "DEBUGSS";
Board.peripheral.swclkPin.$suggestSolution   = "PA20";
Board.peripheral.swdioPin.$suggestSolution   = "PA19";
GPIO1.associatedPins[0].pin.$suggestSolution = "PA8";
GPIO1.associatedPins[1].pin.$suggestSolution = "PA9";
GPIO1.associatedPins[2].pin.$suggestSolution = "PA10";
GPIO1.associatedPins[3].pin.$suggestSolution = "PA11";
GPIO1.associatedPins[4].pin.$suggestSolution = "PA2";
GPIO1.associatedPins[5].pin.$suggestSolution = "PA3";
GPIO1.associatedPins[6].pin.$suggestSolution = "PA15";
GPIO1.associatedPins[7].pin.$suggestSolution = "PA4";
GPIO2.associatedPins[0].pin.$suggestSolution = "PA0";
GPIO2.associatedPins[1].pin.$suggestSolution = "PA1";
GPIO2.associatedPins[2].pin.$suggestSolution = "PA7";
GPIO2.associatedPins[3].pin.$suggestSolution = "PA12";
GPIO2.associatedPins[4].pin.$suggestSolution = "PA13";
GPIO2.associatedPins[5].pin.$suggestSolution = "PA14";
GPIO2.associatedPins[6].pin.$suggestSolution = "PA17/OPA1.IN0-";
GPIO2.associatedPins[7].pin.$suggestSolution = "PA18";
