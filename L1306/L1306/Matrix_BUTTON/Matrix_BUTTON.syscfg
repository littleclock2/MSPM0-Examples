/**
 * @cliArgs --device "MSPM0L130X" --package "VQFN-32(RHB)" --part "Default" --product "mspm0_sdk@1.20.01.06"
 * @versions {"tool":"1.18.1+3343"}
 */

/**
 * Import the modules used in this configuration.
 */
const ADC12   = scripting.addModule("/ti/driverlib/ADC12", {}, false);
const ADC121  = ADC12.addInstance();
const Board   = scripting.addModule("/ti/driverlib/Board");
const COMP    = scripting.addModule("/ti/driverlib/COMP", {}, false);
const COMP1   = COMP.addInstance();
const GPIO    = scripting.addModule("/ti/driverlib/GPIO", {}, false);
const GPIO1   = GPIO.addInstance();
const GPIO2   = GPIO.addInstance();
const OPA     = scripting.addModule("/ti/driverlib/OPA", {}, false);
const OPA1    = OPA.addInstance();
const SYSCTL  = scripting.addModule("/ti/driverlib/SYSCTL");
const SYSTICK = scripting.addModule("/ti/driverlib/SYSTICK");

/**
 * Write custom configuration values to the imported modules.
 */
const gate6  = system.clockTree["MFCLKGATE"];
gate6.enable = true;

const gate7  = system.clockTree["MFPCLKGATE"];
gate7.enable = true;

ADC121.$name                 = "ADC12_0";
ADC121.sampClkSrc            = "DL_ADC12_CLOCK_ULPCLK";
ADC121.sampClkDiv            = "DL_ADC12_CLOCK_DIVIDE_8";
ADC121.samplingOperationMode = "sequence";
ADC121.endAdd                = 1;
ADC121.repeatMode            = true;
ADC121.adcMem1chansel        = "DL_ADC12_INPUT_CHAN_12";
ADC121.adcMem1stime          = "DL_ADC12_SAMPLE_TIMER_SOURCE_SCOMP1";
ADC121.enabledInterrupts     = ["DL_ADC12_INTERRUPT_MEM0_RESULT_LOADED","DL_ADC12_INTERRUPT_MEM1_RESULT_LOADED"];
ADC121.sampCnt               = 1;
ADC121.enabledDMATriggers    = ["DL_ADC12_DMA_MEM0_RESULT_LOADED"];
ADC121.interruptPriority     = "1";
ADC121.sampleTime0           = "0.05 ms";
ADC121.sampleTime1           = "0.05 ms";
ADC121.adcPin0Config.$name   = "ti_driverlib_gpio_GPIOPinGeneric0";


COMP1.$name         = "COMP_0";
COMP1.hysteresis    = "DL_COMP_HYSTERESIS_20";
COMP1.vSource       = "DL_COMP_REF_SOURCE_VDDA_DAC";
COMP1.controlSelect = "DL_COMP_DAC_CONTROL_SW";
COMP1.setDACCode0   = 0x4D;

GPIO1.$name                          = "LED";
GPIO1.associatedPins.create(4);
GPIO1.associatedPins[0].assignedPort = "PORTA";
GPIO1.associatedPins[0].$name        = "LED1";
GPIO1.associatedPins[0].assignedPin  = "8";
GPIO1.associatedPins[1].$name        = "LED2";
GPIO1.associatedPins[1].assignedPin  = "9";
GPIO1.associatedPins[1].assignedPort = "PORTA";
GPIO1.associatedPins[2].assignedPort = "PORTA";
GPIO1.associatedPins[2].$name        = "LED3";
GPIO1.associatedPins[2].assignedPin  = "10";
GPIO1.associatedPins[3].$name        = "LED4";
GPIO1.associatedPins[3].assignedPin  = "11";
GPIO1.associatedPins[3].assignedPort = "PORTA";

GPIO2.$name                          = "GPIO_GRP_0";
GPIO2.associatedPins.create(4);
GPIO2.associatedPins[0].$name        = "CS";
GPIO2.associatedPins[0].initialValue = "SET";
GPIO2.associatedPins[0].assignedPort = "PORTA";
GPIO2.associatedPins[0].assignedPin  = "2";
GPIO2.associatedPins[1].$name        = "D0";
GPIO2.associatedPins[1].assignedPin  = "6";
GPIO2.associatedPins[2].$name        = "D1";
GPIO2.associatedPins[2].assignedPin  = "5";
GPIO2.associatedPins[3].$name        = "DC";
GPIO2.associatedPins[3].assignedPin  = "4";

OPA1.$name              = "OPA_1";
OPA1.cfg0PSELChannel    = "DAC8_OUT";
OPA1.cfg0NSELChannel    = "RTOP";
OPA1.cfg0OutputPin      = "ENABLED";
OPA1.advBW              = "HIGH";
OPA1.OutPinConfig.$name = "ti_driverlib_gpio_GPIOPinGeneric1";

SYSCTL.MFCLKEn     = true;
SYSCTL.MFPCLKEn    = true;
SYSCTL.clockTreeEn = true;

SYSTICK.periodEnable      = true;
SYSTICK.interruptEnable   = true;
SYSTICK.systickEnable     = true;
SYSTICK.period            = 32000;
SYSTICK.interruptPriority = "0";

/**
 * Pinmux solution for unlocked pins/peripherals. This ensures that minor changes to the automatic solver in a future
 * version of the tool will not impact the pinmux you originally saw.  These lines can be completely deleted in order to
 * re-solve from scratch.
 */
ADC121.peripheral.$suggestSolution           = "ADC0";
ADC121.peripheral.adcPin0.$suggestSolution   = "PA27";
Board.peripheral.$suggestSolution            = "DEBUGSS";
Board.peripheral.swclkPin.$suggestSolution   = "PA20";
Board.peripheral.swdioPin.$suggestSolution   = "PA19";
COMP1.peripheral.$suggestSolution            = "COMP0";
GPIO1.associatedPins[0].pin.$suggestSolution = "PA8";
GPIO1.associatedPins[1].pin.$suggestSolution = "PA9";
GPIO1.associatedPins[2].pin.$suggestSolution = "PA10";
GPIO1.associatedPins[3].pin.$suggestSolution = "PA11";
GPIO2.associatedPins[0].pin.$suggestSolution = "PA2";
GPIO2.associatedPins[1].pin.$suggestSolution = "PA6";
GPIO2.associatedPins[2].pin.$suggestSolution = "PA5";
GPIO2.associatedPins[3].pin.$suggestSolution = "PA4";
OPA1.peripheral.$suggestSolution             = "OPA0";
OPA1.peripheral.OutPin.$suggestSolution      = "PA22";
