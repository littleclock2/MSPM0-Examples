/**
 * @cliArgs --device "MSPM0L130X" --package "VQFN-32(RHB)" --part "Default" --product "mspm0_sdk@1.00.01.03"
 * @versions {"tool":"1.16.2+3028"}
 */

/**
 * Import the modules used in this configuration.
 */
const Board  = scripting.addModule("/ti/driverlib/Board");
const GPIO   = scripting.addModule("/ti/driverlib/GPIO", {}, false);
const GPIO1  = GPIO.addInstance();
const SYSCTL = scripting.addModule("/ti/driverlib/SYSCTL");

/**
 * Write custom configuration values to the imported modules.
 */

GPIO1.$name                          = "GPIO_GRP_0";
GPIO1.associatedPins.create(5);
GPIO1.associatedPins[0].$name        = "CS";
GPIO1.associatedPins[0].assignedPort = "PORTA";
GPIO1.associatedPins[0].initialValue = "SET";
GPIO1.associatedPins[0].ioStructure  = "SD";
GPIO1.associatedPins[0].assignedPin  = "2";
GPIO1.associatedPins[1].$name        = "LED";
GPIO1.associatedPins[1].assignedPort = "PORTA";
GPIO1.associatedPins[1].assignedPin  = "14";
GPIO1.associatedPins[2].assignedPin  = "6";
GPIO1.associatedPins[2].$name        = "D0";
GPIO1.associatedPins[3].$name        = "D1";
GPIO1.associatedPins[3].assignedPin  = "4";
GPIO1.associatedPins[4].$name        = "DC";
GPIO1.associatedPins[4].assignedPin  = "5";

SYSCTL.MFCLKEn = true;

/**
 * Pinmux solution for unlocked pins/peripherals. This ensures that minor changes to the automatic solver in a future
 * version of the tool will not impact the pinmux you originally saw.  These lines can be completely deleted in order to
 * re-solve from scratch.
 */
Board.peripheral.$suggestSolution            = "DEBUGSS";
Board.peripheral.swclkPin.$suggestSolution   = "PA20";
Board.peripheral.swdioPin.$suggestSolution   = "PA19";
GPIO1.associatedPins[0].pin.$suggestSolution = "PA2";
GPIO1.associatedPins[1].pin.$suggestSolution = "PA14";
GPIO1.associatedPins[2].pin.$suggestSolution = "PA6";
GPIO1.associatedPins[3].pin.$suggestSolution = "PA4";
GPIO1.associatedPins[4].pin.$suggestSolution = "PA5";
SYSCTL.peripheral.$suggestSolution           = "SYSCTL";
