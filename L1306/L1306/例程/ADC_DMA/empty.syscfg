/**
 * @cliArgs --device "MSPM0L130X" --package "VQFN-32(RHB)" --part "Default" --product "mspm0_sdk@1.00.01.03"
 * @versions {"tool":"1.16.1+2960"}
 */

/**
 * Import the modules used in this configuration.
 */
const ADC12  = scripting.addModule("/ti/driverlib/ADC12", {}, false);
const ADC121 = ADC12.addInstance();
const Board  = scripting.addModule("/ti/driverlib/Board");

/**
 * Write custom configuration values to the imported modules.
 */
ADC121.$name                    = "ADC12_0";
ADC121.sampClkSrc               = "DL_ADC12_CLOCK_ULPCLK";
ADC121.adcMem0chansel           = "DL_ADC12_INPUT_CHAN_9";
ADC121.configureDMA             = true;
ADC121.sampCnt                  = 1;
ADC121.enabledInterrupts        = ["DL_ADC12_INTERRUPT_DMA_DONE"];
ADC121.repeatMode               = true;
ADC121.enabledDMATriggers       = ["DL_ADC12_DMA_MEM0_RESULT_LOADED"];
ADC121.sampleTime0              = "1us";
ADC121.DMA_CHANNEL.$name        = "DMA_CH0";
ADC121.DMA_CHANNEL.srcLength    = "HALF_WORD";
ADC121.DMA_CHANNEL.dstLength    = "HALF_WORD";
ADC121.DMA_CHANNEL.transferSize = 10;
ADC121.DMA_CHANNEL.addressMode  = "f2b";


const SYSCTL = scripting.addModule("/ti/driverlib/SYSCTL", {}, false);

/**
 * Pinmux solution for unlocked pins/peripherals. This ensures that minor changes to the automatic solver in a future
 * version of the tool will not impact the pinmux you originally saw.  These lines can be completely deleted in order to
 * re-solve from scratch.
 */
ADC121.peripheral.$suggestSolution             = "ADC0";
ADC121.peripheral.adcPin9.$suggestSolution     = "PA15";
ADC121.DMA_CHANNEL.peripheral.$suggestSolution = "DMA_CH0";
Board.peripheral.$suggestSolution              = "DEBUGSS";
Board.peripheral.swclkPin.$suggestSolution     = "PA20";
Board.peripheral.swdioPin.$suggestSolution     = "PA19";
SYSCTL.peripheral.$suggestSolution             = "SYSCTL";
