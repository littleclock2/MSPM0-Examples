/**
 * @cliArgs --device "MSPM0L130X" --package "VQFN-32(RHB)" --part "Default" --product "mspm0_sdk@1.00.01.03"
 * @versions {"tool":"1.16.1+2960"}
 */

/**
 * Import the modules used in this configuration.
 */
const Board  = scripting.addModule("/ti/driverlib/Board");
const GPIO   = scripting.addModule("/ti/driverlib/GPIO", {}, false);
const GPIO1  = GPIO.addInstance();
const SYSCTL = scripting.addModule("/ti/driverlib/SYSCTL");
const TIMER  = scripting.addModule("/ti/driverlib/TIMER", {}, false);
const TIMER1 = TIMER.addInstance();
const WWDT   = scripting.addModule("/ti/driverlib/WWDT", {}, false);
const WWDT1  = WWDT.addInstance();

/**
 * Write custom configuration values to the imported modules.
 */

GPIO1.$name                             = "GPIO_GRP_0";
GPIO1.associatedPins[0].assignedPort    = "PORTA";
GPIO1.associatedPins[0].initialValue    = "SET";
GPIO1.associatedPins[0].ioStructure     = "SD";
GPIO1.associatedPins[0].$name           = "LED";
GPIO1.associatedPins[0].assignedPin     = "14";
GPIO1.associatedPins[0].subChanID       = 1;
GPIO1.associatedPins[0].subOutputPolicy = "TOGGLE";


TIMER1.$name            = "TIMER_0";
TIMER1.timerClkSrc      = "LFCLK";
TIMER1.timerClkPrescale = 33;
TIMER1.timerMode        = "PERIODIC";
TIMER1.timerPeriod      = "300 ms";
TIMER1.interrupts       = ["ZERO"];

WWDT1.$name               = "WWDT0";
WWDT1.window0ClosedPeriod = "25";

/**
 * Pinmux solution for unlocked pins/peripherals. This ensures that minor changes to the automatic solver in a future
 * version of the tool will not impact the pinmux you originally saw.  These lines can be completely deleted in order to
 * re-solve from scratch.
 */
Board.peripheral.$suggestSolution            = "DEBUGSS";
Board.peripheral.swclkPin.$suggestSolution   = "PA20";
Board.peripheral.swdioPin.$suggestSolution   = "PA19";
GPIO1.associatedPins[0].pin.$suggestSolution = "PA14";
SYSCTL.peripheral.$suggestSolution           = "SYSCTL";
TIMER1.peripheral.$suggestSolution           = "TIMG0";
WWDT1.peripheral.$suggestSolution            = "WWDT0";
