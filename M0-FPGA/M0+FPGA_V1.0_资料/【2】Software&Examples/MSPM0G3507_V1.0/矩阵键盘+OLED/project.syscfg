/**
 * @cliArgs --device "MSPM0L130X" --package "VQFN-32(RHB)" --part "Default" --product "mspm0_sdk@1.20.01.06"
 * @versions {"tool":"1.18.1+3343"}
 */

/**
 * Import the modules used in this configuration.
 */
const Board  = scripting.addModule("/ti/driverlib/Board");
const GPIO   = scripting.addModule("/ti/driverlib/GPIO", {}, false);
const GPIO1  = GPIO.addInstance();
const GPIO2  = GPIO.addInstance();
const SYSCTL = scripting.addModule("/ti/driverlib/SYSCTL");

/**
 * Write custom configuration values to the imported modules.
 */
const gate6  = system.clockTree["MFCLKGATE"];
gate6.enable = true;

const gate7  = system.clockTree["MFPCLKGATE"];
gate7.enable = true;


GPIO1.$name                              = "KEY";
GPIO1.associatedPins.create(8);
GPIO1.associatedPins[0].$name            = "H1";
GPIO1.associatedPins[0].assignedPin      = "0";
GPIO1.associatedPins[0].internalResistor = "PULL_UP";
GPIO1.associatedPins[1].$name            = "H2";
GPIO1.associatedPins[1].assignedPin      = "1";
GPIO1.associatedPins[1].internalResistor = "PULL_UP";
GPIO1.associatedPins[2].$name            = "H3";
GPIO1.associatedPins[2].assignedPin      = "7";
GPIO1.associatedPins[3].$name            = "H4";
GPIO1.associatedPins[3].assignedPin      = "12";
GPIO1.associatedPins[4].$name            = "V1";
GPIO1.associatedPins[4].direction        = "INPUT";
GPIO1.associatedPins[4].assignedPin      = "13";
GPIO1.associatedPins[4].internalResistor = "PULL_DOWN";
GPIO1.associatedPins[5].$name            = "V2";
GPIO1.associatedPins[5].assignedPin      = "14";
GPIO1.associatedPins[5].direction        = "INPUT";
GPIO1.associatedPins[5].internalResistor = "PULL_DOWN";
GPIO1.associatedPins[6].$name            = "V3";
GPIO1.associatedPins[6].assignedPin      = "17";
GPIO1.associatedPins[6].direction        = "INPUT";
GPIO1.associatedPins[6].internalResistor = "PULL_DOWN";
GPIO1.associatedPins[7].$name            = "V4";
GPIO1.associatedPins[7].assignedPin      = "18";
GPIO1.associatedPins[7].direction        = "INPUT";
GPIO1.associatedPins[7].internalResistor = "PULL_DOWN";

GPIO2.$name                         = "GPIO_GRP_0";
GPIO2.associatedPins.create(4);
GPIO2.associatedPins[0].$name       = "CS";
GPIO2.associatedPins[0].assignedPin = "2";
GPIO2.associatedPins[1].$name       = "DC";
GPIO2.associatedPins[1].assignedPin = "4";
GPIO2.associatedPins[2].$name       = "D0";
GPIO2.associatedPins[2].assignedPin = "6";
GPIO2.associatedPins[3].$name       = "D1";
GPIO2.associatedPins[3].assignedPin = "5";

SYSCTL.MFCLKEn     = true;
SYSCTL.MFPCLKEn    = true;
SYSCTL.clockTreeEn = true;

/**
 * Pinmux solution for unlocked pins/peripherals. This ensures that minor changes to the automatic solver in a future
 * version of the tool will not impact the pinmux you originally saw.  These lines can be completely deleted in order to
 * re-solve from scratch.
 */
Board.peripheral.$suggestSolution            = "DEBUGSS";
Board.peripheral.swclkPin.$suggestSolution   = "PA20";
Board.peripheral.swdioPin.$suggestSolution   = "PA19";
GPIO1.associatedPins[0].pin.$suggestSolution = "PA0";
GPIO1.associatedPins[1].pin.$suggestSolution = "PA1";
GPIO1.associatedPins[2].pin.$suggestSolution = "PA7";
GPIO1.associatedPins[3].pin.$suggestSolution = "PA12";
GPIO1.associatedPins[4].pin.$suggestSolution = "PA13";
GPIO1.associatedPins[5].pin.$suggestSolution = "PA14";
GPIO1.associatedPins[6].pin.$suggestSolution = "PA17/OPA1.IN0-";
GPIO1.associatedPins[7].pin.$suggestSolution = "PA18";
GPIO2.associatedPins[0].pin.$suggestSolution = "PA2";
GPIO2.associatedPins[1].pin.$suggestSolution = "PA4";
GPIO2.associatedPins[2].pin.$suggestSolution = "PA6";
GPIO2.associatedPins[3].pin.$suggestSolution = "PA5";
